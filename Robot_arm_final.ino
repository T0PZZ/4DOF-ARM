#include "U8glib.h"
#define SCK A0
#define SDA A1
#define RES A2  // oled screen library, pins and U8g constructor
#define DC A3
#define CS A4
U8GLIB_SH1106_128X64 u8g(SCK, SDA, CS, DC, RES);

// buttons  servo_number_position(increment/decrement)
#define servo_1_plus 7   // turn arm right
#define servo_1_minus 6  // turn arm left
#define servo_2_plus 5   // lift claw
#define servo_2_minus 4  // lower claw
#define servo_3_plus 3   // move claw forward
#define servo_3_minus 2  // move claw backward
#define servo_4_plus 1   // claw pinnch
#define servo_4_minus 0  // claw release

#include <Servo.h>  // Servo library
#define servo_1 13  // rotation OY
#define servo_2 12  // claw OY movement
#define servo_3 11  // claw OX movement
#define servo_4 10  // claw pinching

Servo s1, s2, s3, s4;                                                                              // servo declaration
int servo_1_position = 90, servo_2_position = 120, servo_3_position = 30, servo_4_position = 100;  // servo initial positions
int position_change = 4, pinch = 2;                                                                // incrementatnion/decrementation values, pinch is meant for claw;

float servo_1_percents;
float servo_2_percents;
float servo_3_percents;
float servo_4_percents;  // float values to calculate percent usage

byte servo_1_percent_usage;
byte servo_2_percent_usage;
byte servo_3_percent_usage;
byte servo_4_percent_usage;  // rounded float values to calculate percent usage

byte MODE = 0;

#define GUI_width 128  // Defining GUI bitmap
#define GUI_height 64
static unsigned char GUI_bits[] U8G_PROGMEM = {
  0x00, 0x40, 0x00, 0x00, 0x00, 0x00, 0x00, 0x00, 0x01, 0x40, 0x00, 0x00,
  0x00, 0x00, 0x00, 0x00, 0x20, 0x41, 0x00, 0x00, 0x00, 0x00, 0x00, 0x00,
  0x79, 0x42, 0x00, 0x00, 0x00, 0x00, 0x00, 0x00, 0x30, 0x42, 0x00, 0x00,
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  0x00, 0x00, 0x00, 0x00
};

#define logo_we_black_width 128  // Defining WEiI Bitmap
#define logo_we_black_height 64
static unsigned char logo_we_black_bits[] U8G_PROGMEM = {
  0x00, 0x00, 0x00, 0x00, 0x00, 0x00, 0x00, 0x00, 0x00, 0x00, 0x00, 0x00,
  0x00, 0x00, 0x00, 0x00, 0x00, 0x00, 0x00, 0x00, 0x00, 0x00, 0x00, 0x00,
  0x00, 0x00, 0x00, 0x00, 0x00, 0x00, 0x00, 0x00, 0x00, 0x00, 0x00, 0x00,
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  0x00, 0x00, 0x00, 0x00
};

#define logo_wm_black_width 128
#define logo_wm_black_height 64  // Defining WM bitmap
static unsigned char logo_wm_black_bits[] U8G_PROGMEM = {
  0x00, 0x00, 0x00, 0x00, 0x00, 0x00, 0x00, 0x00, 0x00, 0x00, 0x00, 0x00,
  0x00, 0x00, 0x00, 0x00, 0x00, 0x00, 0x00, 0x00, 0x00, 0x00, 0x00, 0x00,
  0x00, 0x00, 0x00, 0x00, 0x00, 0x00, 0x00, 0x00, 0x00, 0x00, 0x00, 0x00,
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  0x00, 0x00, 0x00, 0x00
};

void draw_wm_black(void) {  // draw WM LOGO
  u8g.firstPage();
  do { u8g.drawXBMP(0, 0, logo_wm_black_width, logo_wm_black_height, logo_wm_black_bits); } while (u8g.nextPage());
  delay(2500);
}

void draw_we_black(void) {  // draw WE LOGO
  u8g.firstPage();
  do { u8g.drawXBMP(0, 0, logo_we_black_width, logo_we_black_height, logo_we_black_bits); } while (u8g.nextPage());
  delay(2500);
}
void draw_GUI(void) {  // draw GUI bitmap
  u8g.drawXBMP(0, 0, GUI_width, GUI_height, GUI_bits);
}

void update_positions(void) {  // calculate percent usages, round them and display at set cooords to match GUI

  servo_1_percents = (servo_1_position / 180.0 * 100.0);  // calculate percent usage
  servo_2_percents = ((servo_2_position - 60.0) / 120.0 * 100.0);
  servo_3_percents = ((servo_3_position - 20.0) / 60.0 * 100.0);
  servo_4_percents = ((servo_4_position - 70.0) / 50.0 * 100.0);

  servo_1_percent_usage = round(servo_1_percents);  // round float values in order to display them properly
  servo_2_percent_usage = round(servo_2_percents);
  servo_3_percent_usage = round(servo_3_percents);
  servo_4_percent_usage = round(servo_4_percents);

  //u8g.setFont(u8g_font_unifont);
  // u8g.setFont(u8g_font_6x10);
  // u8g.setPrintPos(30, 12);
  // u8g.print(servo_1_percent_usage);
  // u8g.setPrintPos(95, 12);
  // u8g.print(servo_2_percent_usage);
  // u8g.setPrintPos(30, 45);
  // u8g.print(servo_3_percent_usage);
  // u8g.setPrintPos(95, 45);
  // u8g.print(servo_4_percent_usage);

  u8g.setFont(u8g_font_6x10);
  u8g.setPrintPos(30, 9);
  u8g.print(servo_1_percent_usage);
  u8g.drawStr(50, 9, "%");

  u8g.setPrintPos(95, 9);
  u8g.print(servo_2_percent_usage);
  u8g.drawStr(120, 9, "%");

  u8g.setPrintPos(30, 42);
  u8g.print(servo_3_percent_usage);
  u8g.drawStr(50, 42, "%");

  u8g.setPrintPos(95, 42);
  u8g.drawStr(120, 42, "%");
  u8g.print(servo_4_percent_usage);
}

void servo_control() {  // if servo_x_plus is pressed increment position, if servo_x_minus is pressed decrement position, write position to servomotor

  if (digitalRead(servo_1_plus) == LOW && servo_1_position <= 180) {  // increment servo 1 position if position <= max position & button pressed
    servo_1_position = servo_1_position + 4;
    if (servo_1_position > 180) { servo_1_position = 180; };
    s1.write(servo_1_position);
  }

  if (digitalRead(servo_1_minus) == LOW && servo_1_position >= 0) {  // decrement servo 1 position if position >= min position & button pressed
    servo_1_position = servo_1_position - position_change;
    if (servo_1_position < 0) { servo_1_position = 0; };
    s1.write(servo_1_position);
  }

  if (digitalRead(servo_2_plus) == LOW && servo_2_position <= 180) {  // increment servo 2 position if position < max position & button pressed
    servo_2_position = servo_2_position + position_change;
    if (servo_2_position > 180) { servo_2_position = 180; };
    s2.write(servo_2_position);
  }

  if (digitalRead(servo_2_minus) == LOW && servo_2_position >= 0) {  // decrement servo 2 position if position >= min position & button pressed
    servo_2_position = servo_2_position - position_change;
    if (servo_2_position < 60) { servo_2_position = 60; };
    s2.write(servo_2_position);
  }

  if (digitalRead(servo_3_plus) == LOW && servo_3_position <= 80) {  // increment servo 3 position if position < max position & button pressed
    servo_3_position = servo_3_position + position_change;
    if (servo_3_position > 80) { servo_3_position = 80; };
    s3.write(servo_3_position);
  }

  if (digitalRead(servo_3_minus) == LOW && servo_3_position >= 20) {  // decrement servo 3 position if position >= min position & button pressed
    servo_3_position = servo_3_position - position_change;
    if (servo_3_position < 20) { servo_3_position = 20; };
    s3.write(servo_3_position);
  }

  if (digitalRead(servo_4_plus) == LOW && servo_4_position <= 180) {  // increment servo 4 position if position < max position & button pressed
    servo_4_position = servo_4_position + pinch;
    if (servo_4_position > 120) { servo_4_position = 120; };
    s4.write(servo_4_position);
  }

  if (digitalRead(servo_4_minus) == LOW && servo_4_position >= 70) {  // decrement servo 4 position if position >= min position & button pressed
    servo_4_position = servo_4_position - pinch;
    if (servo_4_position < 70) { servo_4_position = 70; };
    s4.write(servo_4_position);
  }
}

void usage_bar(void) {                                // draw progress bar showing servo_x percent usage
  u8g.drawBox(15, 10, 50, 1);                         // upper bar border for servo 1
  u8g.drawBox(15, 11, servo_1_percent_usage / 2, 3);  // servo 1 progress bar

  u8g.drawBox(79, 10, 50, 1);                         // upper bar border for servo 2
  u8g.drawBox(79, 11, servo_2_percent_usage / 2, 3);  // servo 2 progress bar

  u8g.drawBox(15, 43, 50, 1);                         // upper bar border for servo 3
  u8g.drawBox(15, 44, servo_3_percent_usage / 2, 3);  // servo 3 progress bar

  u8g.drawBox(79, 43, 50, 1);                         // upper bar border for servo
  u8g.drawBox(79, 44, servo_4_percent_usage / 2, 3);  // servo 4 progress bar
}


void setup() {

  s1.attach(servo_1);
  s1.write(servo_1_position);  // Attaching servos and setting their position to default
  s2.attach(servo_2);
  s2.write(servo_2_position);
  s3.attach(servo_3);
  s3.write(servo_3_position);
  s4.attach(servo_4);
  s4.write(servo_4_position);

  pinMode(servo_1_plus, INPUT_PULLUP);  // Arduino ports configured as inputs with internal pullup resistor
  pinMode(servo_1_minus, INPUT_PULLUP);
  pinMode(servo_2_plus, INPUT_PULLUP);
  pinMode(servo_2_minus, INPUT_PULLUP);
  pinMode(servo_3_plus, INPUT_PULLUP);
  pinMode(servo_3_minus, INPUT_PULLUP);
  pinMode(servo_4_plus, INPUT_PULLUP);
  pinMode(servo_4_minus, INPUT_PULLUP);

  draw_we_black();  // Draw WEiI LOGO
}

void loop() {
  // switch (MODE) {
  //   cases
  // }
  u8g.firstPage();
  do {
    draw_GUI();
    update_positions();
    usage_bar();
  } while (u8g.nextPage());
  servo_control();
}
